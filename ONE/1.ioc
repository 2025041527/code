# file: 1.ioc
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Mcu.Family=STM32F1
Mcu.Name=STM32F103R(C-D-E)Tx
Mcu.Package=LQFP64
NVIC.PriorityGroup=NVIC_PRIORITYGROUP_4
PA13.Mode=Serial_Wire
PA13.Signal=SYS_JTMS-SWDIO
PA14.Mode=Serial_Wire
PA14.Signal=SYS_JTCK-SWCLK
PD0-OSC_IN.Mode=HSE-External-Oscillator
PD0-OSC_IN.Signal=RCC_OSC_IN
PD1-OSC_OUT.Mode=HSE-External-Oscillator
PD1-OSC_OUT.Signal=RCC_OSC_OUT
ProjectManager.HeapSize=0x200
ProjectManager.StackSize=0x400
ProjectManager.TargetToolchain=Makefile
RCC.AHBFreq_Value=72000000
RCC.APB1CLKDivider=RCC_HCLK_DIV2
RCC.APB1Freq_Value=36000000
RCC.APB1TimFreq_Value=72000000
RCC.APB2Freq_Value=72000000
RCC.APB2TimFreq_Value=72000000
RCC.HCLKFreq_Value=72000000
RCC.PLLMUL=RCC_PLL_MUL9
RCC.PLLSourceVirtual=RCC_PLLSOURCE_HSE
RCC.SYSCLKFreq_VALUE=72000000
RCC.SYSCLKSource=RCC_SYSCLKSOURCE_PLLCLK
RCC.USBFreq_Value=72000000
board=custom

// file: Core/Src/main.c
/* USER CODE BEGIN Header */
/**
  ******************************************************************************
  * @file           : main.c
  * @brief          : Main program body
  ******************************************************************************
  * @attention
  *
  * Copyright (c) 2026 STMicroelectronics.
  * All rights reserved.
  *
  * This software is licensed under terms that can be found in the LICENSE file
  * in the root directory of this software component.
  * If no LICENSE file comes with this software, it is provided AS-IS.
  *
  ******************************************************************************
  */
/* USER CODE END Header */
#include "main.h"
#include "gpio.h"
#include "bsp_dwt.h"
#include "motor_simulation.h"

/* USER CODE BEGIN PD */
#define PID_OUTPUT_MAX 24.0f
#define PID_OUTPUT_MIN -24.0f
#define PID_INTEGRAL_MAX 24.0f
#define PID_INTEGRAL_MIN -24.0f

/* USER CODE BEGIN PV */
float velocityRef;
typedef struct {
    float kp;
    float ki;
    float kd;
    float integral;
    float prev_error;
	  float Input;
	  float Current;
} pid_t;

motorObject_t Motor;
pid_t PID;
uint32_t DWT_CNT;
float dt;
float t;

/* USER CODE END PV */

void SystemClock_Config(void);
/* USER CODE BEGIN PFP */
void PID_Init(pid_t *p);
float PID_Calculate(float setpoint, float dt, pid_t *PID, float current);
/* USER CODE END PFP */

/* USER CODE BEGIN 0 */
void PID_Init(pid_t *p)
{
    if (!p) return;
    p->kp = 1.0f;
    p->ki = 0.0f;
    p->kd = 0.0f;
    p->integral = 0.0f;
    p->prev_error = 0.0f;
}

float PID_Calculate(float setpoint, float dt, pid_t *PID, float current)
{
    if (dt <= 0.0f) return 0.0f;
    float error = setpoint - current;

    PID->integral += error * dt;
    PID->integral = (PID->integral > PID_INTEGRAL_MAX) ? PID_INTEGRAL_MAX :
                   (PID->integral < PID_INTEGRAL_MIN) ? PID_INTEGRAL_MIN : PID->integral;

    float derivative = (error - PID->prev_error) / dt;

    float out = PID->kp * error + PID->ki * PID->integral + PID->kd * derivative;
    out = (out > PID_OUTPUT_MAX) ? PID_OUTPUT_MAX :
          (out < PID_OUTPUT_MIN) ? PID_OUTPUT_MIN : out;

    PID->prev_error = error;
    return out;
}
/* USER CODE END 0 */

int main(void)
{

  HAL_Init();

  SystemClock_Config();

  MX_GPIO_Init();

  /* USER CODE BEGIN 2 */
  DWT_Init(72);
  Motor_Object_Init(&Motor);
  PID_Init(&PID);
  DWT_CNT = 0;
  dt = 0.0f;
  t = 0.0f;
  velocityRef = 0.0f;
  /* USER CODE END 2 */

  while (1)
  {
      dt = DWT_GetDeltaT(&DWT_CNT);
      t += dt;

      PID.Current = Get_Motor_Current(&Motor);
      Motor.Velocity = Get_Motor_Velocity(&Motor);
      Motor.Angle = Get_Motor_Angle(&Motor);
      velocityRef = 10.0f;
      PID.Input = PID_Calculate(velocityRef, dt, &PID, Motor.Velocity);

      Motor_Simulation(&Motor,PID.Input, dt);

      /* USER CODE END WHILE */

      /* USER CODE BEGIN 3 */
      HAL_Delay(1);
  }
  /* USER CODE END 3 */
}

void SystemClock_Config(void)
{
  RCC_OscInitTypeDef RCC_OscInitStruct = {0};
  RCC_ClkInitTypeDef RCC_ClkInitStruct = {0};

  RCC_OscInitStruct.OscillatorType = RCC_OSCILLATORTYPE_HSE;
  RCC_OscInitStruct.HSEState = RCC_HSE_ON;
  RCC_OscInitStruct.HSEPredivValue = RCC_HSE_PREDIV_DIV1;
  RCC_OscInitStruct.HSIState = RCC_HSI_ON;
  RCC_OscInitStruct.PLL.PLLState = RCC_PLL_ON;
  RCC_OscInitStruct.PLL.PLLSource = RCC_PLLSOURCE_HSE;
  RCC_OscInitStruct.PLL.PLLMUL = RCC_PLL_MUL9;
  if (HAL_RCC_OscConfig(&RCC_OscInitStruct) != HAL_OK)
  {
    Error_Handler();
  }

  RCC_ClkInitStruct.ClockType = RCC_CLOCKTYPE_HCLK|RCC_CLOCKTYPE_SYSCLK
                              |RCC_CLOCKTYPE_PCLK1|RCC_CLOCKTYPE_PCLK2;
  RCC_ClkInitStruct.SYSCLKSource = RCC_SYSCLKSOURCE_PLLCLK;
  RCC_ClkInitStruct.AHBCLKDivider = RCC_SYSCLK_DIV1;
  RCC_ClkInitStruct.APB1CLKDivider = RCC_HCLK_DIV2;
  RCC_ClkInitStruct.APB2CLKDivider = RCC_HCLK_DIV1;

  if (HAL_RCC_ClockConfig(&RCC_ClkInitStruct, FLASH_LATENCY_2) != HAL_OK)
  {
    Error_Handler();
  }
}

void Error_Handler(void)
{
  __disable_irq();
  while (1)
  {
  }
}
